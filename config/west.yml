## config/west.yml
```yaml
manifest:
  remotes:
    - name: zmkfirmware
      url-base: https://github.com/zmkfirmware
    - name: geigeigeist
      url-base: https://github.com/GEIGEIGEIST
    - name: englmaxi
      url-base: https://github.com/englmaxi
  projects:
    - name: zmk
      remote: zmkfirmware
      revision: main
      import: app/west.yml
    - name: zmk-config-totem
      remote: geigeigeist
      revision: master
    - name: zmk-hid-trackball-interface
      remote: englmaxi
      revision: main
  self:
    path: config
```
